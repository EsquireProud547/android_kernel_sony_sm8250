## drivers/rekernel/Kconfig
```kconfig
config REKERNEL
	bool "Re:Kernel event reporting support"
	default n
	help
	  Enable Re:Kernel event reporting for tombstone apps using
	  librekernel. This source-integrated implementation registers the
	  Generic Netlink family "rekernel" matching the upstream LKM and
	  emits Binder, Signal and (optionally) Network events for frozen
	  processes.

	  This is intended for non-GKI/QGKI kernels where the upstream LKM
	  vendor-hook path is not available.

config REKERNEL_NETWORK
	bool "Re:Kernel network monitoring"
	depends on REKERNEL
	depends on NETFILTER
	default n
	help
	  Enable inbound network monitoring. Userspace can register UIDs to
	  monitor via the ADD_MONITOR_NET Generic Netlink command and tear
	  down a process' sockets via KILL_NET. This mirrors the upstream LKM
	  netfilter implementation.
```
